## CMakeLists.txt
```
# SPDX-License-Identifier: Apache-2.0

cmake_minimum_required(VERSION 3.20.0)
find_package(Zephyr REQUIRED HINTS $ENV{ZEPHYR_BASE})
project(thread_zbus)

target_sources(app PRIVATE src/main.c)
```

## prj.conf
```kconfig
CONFIG_LOG=y
CONFIG_ZBUS=y
CONFIG_ENTROPY_GENERATOR=y
CONFIG_HEAP_MEM_POOL_SIZE=1024
```

## src/main.c
```c
#include <zephyr/kernel.h>
#include <zephyr/logging/log.h>
#include <zephyr/random/random.h>
#include <zephyr/zbus/zbus.h>

LOG_MODULE_REGISTER(prod_cons_zbus, LOG_LEVEL_INF);

struct data_sample {
    uint32_t timestamp;
    uint32_t data;
};

static void consumer_a_callback(const struct zbus_channel *chan)
{
    const struct data_sample *sample;

    LOG_DBG("Consumer A: Listener callback triggered!");
    
    /* Get direct pointer to channel message data */
    sample = zbus_chan_const_msg(chan);
    
    LOG_INF("Consumer A: %u | Consumed data: %u", sample->timestamp, sample->data);
}

static void consumer_b_callback(const struct zbus_channel *chan)
{
    const struct data_sample *sample;

    LOG_DBG("Consumer B: Listener callback triggered!");
    
    /* Get direct pointer to channel message data */
    sample = zbus_chan_const_msg(chan);
    
    LOG_INF("Consumer B: %u | Consumed data: %u", sample->timestamp, sample->data);
}

ZBUS_LISTENER_DEFINE(consumer_a_lis, consumer_a_callback);
ZBUS_LISTENER_DEFINE(consumer_b_lis, consumer_b_callback);

ZBUS_CHAN_DEFINE(data_chan,
                 struct data_sample,
                 NULL,
                 NULL,
                 ZBUS_OBSERVERS(consumer_a_lis, consumer_b_lis),
                 ZBUS_MSG_INIT(.timestamp = 0, .data = 0));

static void producer_thread(void)
{
    struct data_sample sample;
    uint32_t timestamp = 0;

    /* Wait for system to be ready */
    k_msleep(1000);

    while (1) {
        sample.timestamp = timestamp++;
        sample.data = sys_rand32_get();

        int ret = zbus_chan_pub(&data_chan, &sample, K_NO_WAIT);
        if (ret == 0) {
            LOG_INF("Producer  : %u | Produced data: %u", sample.timestamp, sample.data);
        } else {
            LOG_ERR("Failed to publish data, ret: %d", ret);
        }

        k_msleep(1000);
    }
}

#define P_STACK_SIZE 1024
#define P_PRIORITY 5

K_THREAD_DEFINE(prod_tid, P_STACK_SIZE, producer_thread, NULL, NULL, NULL, P_PRIORITY, 0, 0);

int main(void)
{
    LOG_INF("Producer-Consumer example using Zbus with TWO Listeners");
    return 0;
}
```
