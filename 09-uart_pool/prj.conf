## prj.conf
```kconfig
#Config Serial
CONFIG_SERIAL=y

# Config logger
CONFIG_LOG=y
CONFIG_LOG_MODE_IMMEDIATE=y

#RTT
# CONFIG_USE_SEGGER_RTT=y
# CONFIG_RTT_CONSOLE=y
# CONFIG_UART_CONSOLE=n
# CONFIG_LOG_BACKEND_RTT=y
# CONFIG_LOG_BACKEND_UART=n
```

## boards/nrf52840dk_nrf52840.overlay
```dts
&uart1 {
    status = "okay";
    current-speed = <115200>;
};

&spi1 {
    status = "disabled";
};
```

## src/main.c
```c
#include <zephyr/kernel.h>
#include <zephyr/device.h>
#include <zephyr/drivers/uart.h>
#include <zephyr/logging/log.h>

LOG_MODULE_REGISTER(uart_echo, LOG_LEVEL_DBG);

#define UART_NODE DT_ALIAS(work_uart)
const struct device *uart = DEVICE_DT_GET(UART_NODE);

int main(void)
{
    LOG_INF("Starting UART Echo\n");
    if (!device_is_ready(uart)) {
        return -1;
    }

    unsigned char c;

    while (1) {
        if (uart_poll_in(uart, &c) == 0) {
            uart_poll_out(uart, c);
            LOG_DBG("%c", c);
        }
        k_yield();
    }
}
```
