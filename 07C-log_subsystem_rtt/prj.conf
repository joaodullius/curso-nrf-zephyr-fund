## prj.conf
```kconfig
CONFIG_LOG=y
CONFIG_LOG_APP_LOG_LEVEL_DBG=y

CONFIG_USE_SEGGER_RTT=y

CONFIG_UART_CONSOLE=n
CONFIG_RTT_CONSOLE=y

CONFIG_LOG_BACKEND_RTT=y
CONFIG_LOG_BACKEND_UART=n
```

## src/main.c
```c
#include <zephyr/kernel.h>
#include <zephyr/logging/log.h>
#include <zephyr/sys/printk.h>
#include <string.h>

LOG_MODULE_REGISTER(Aplicacao_Log, CONFIG_LOG_APP_LOG_LEVEL);

void simulate_logging(void)
{
    
}

int main(void)
{
	LOG_INF("Mensagem informativa de status.");
    LOG_WRN("Aviso detectado em operação.");
    LOG_ERR("Erro simulado no subsistema!");
    LOG_DBG("Mensagem de debug (detalhes internos).");

    const char buffer[] = "Mensagem binária";
    LOG_HEXDUMP_INF(buffer, strlen(buffer), "Dump de memória");
}
```
