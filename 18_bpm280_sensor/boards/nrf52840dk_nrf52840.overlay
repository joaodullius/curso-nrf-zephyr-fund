
// &i2c0 {
//     bmp280: bmp280@76 {
//         compatible = "bosch,bmp280";
//         reg = <0x76>;
//         label = "BMP280";
//     };
// };

&i2c0 {
	bmp280@76 {
			compatible = "bosch,bme280";
			reg = <0x76>; /* Endereço I2C do BMP180 */
		};
	};

